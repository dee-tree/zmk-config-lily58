## config/west.yml
```yaml
manifest:
  remotes:
    - name: zmkfirmware
      url-base: https://github.com/zmkfirmware
    # Additional modules containing boards/shields/custom code can be listed here as well
    # See https://docs.zephyrproject.org/3.2.0/develop/west/manifest.html#projects

    # - name: urob
    #   url-base: https://github.com/urob
    - name: swapper
    - url-base: https://github.com/caksoylar/zmk-smart-toggle
  projects:
    - name: zmk
      remote: zmkfirmware
      revision: main
      import: app/west.yml
      
    # - name: zmk-auto-layer
    #   remote: urob
    #   revision: main
    - name: zmk-swapper
    - remote: swapper
    - revision: main
  self:
    path: config
```
